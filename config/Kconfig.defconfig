## config/Kconfig.defconfig
```kconfig
if SHIELD_MYAX_LEFT

config ZMK_KEYBOARD_NAME
    default "Myax"

config ZMK_SPLIT_ROLE_CENTRAL
    default y

endif

if SHIELD_MYAX_LEFT || SHIELD_MYAX_RIGHT

config ZMK_SPLIT
    default y

endif
```

## config/boards/shields/Kconfig.defconfig
```kconfig
if SHIELD_MYAX

config ZMK_KEYBOARD_NAME
    default "Myax"

config ZMK_SPLIT_ROLE_CENTRAL
    default y

endif

if SHIELD_MYAX

config ZMK_SPLIT
    default y

endif
```

## config/west.yml
```yaml
manifest:
  remotes:
    - name: dnlbauer
      url-base: https://github.com/dnlbauer
    - name: zmkfirmware
      url-base: https://github.com/zmkfirmware
  projects:
    - name: zmk
      remote: zmkfirmware
      revision: main
      import: app/west.yml
    - name: zmk-keyboards-corax
      remote: dnlbauer
      revision: main
  self:
    path: config
```
